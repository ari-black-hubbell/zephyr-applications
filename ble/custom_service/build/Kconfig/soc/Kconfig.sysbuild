## ble/custom_service/build/Kconfig/soc/Kconfig.sysbuild
```kconfig
# Load SoC sysbuild Kconfig descriptions.
osource "/Users/ariannnahblack/zephyrproject/zephyr/soc/xlnx/zynqmp/Kconfig.sysbuild"
osource "/Users/ariannnahblack/zephyrproject/zephyr/soc/xlnx/zynq7000/Kconfig.sysbuild"
osource "/Users/ariannnahblack/zephyrproject/zephyr/soc/xen/Kconfig.sysbuild"
osource "/Users/ariannnahblack/zephyrproject/zephyr/soc/ti/simplelink/Kconfig.sysbuild"
osource "/Users/ariannnahblack/zephyrproject/zephyr/soc/ti/lm3s6965/Kconfig.sysbuild"
osource "/Users/ariannnahblack/zephyrproject/zephyr/soc/ti/k3/Kconfig.sysbuild"
osource "/Users/ariannnahblack/zephyrproject/zephyr/soc/telink/tlsr/Kconfig.sysbuild"
osource "/Users/ariannnahblack/zephyrproject/zephyr/soc/starfive/jh71xx/Kconfig.sysbuild"
osource "/Users/ariannnahblack/zephyrproject/zephyr/soc/st/stm32/Kconfig.sysbuild"
osource "/Users/ariannnahblack/zephyrproject/zephyr/soc/snps/qemu_arc/Kconfig.sysbuild"
osource "/Users/ariannnahblack/zephyrproject/zephyr/soc/snps/nsim/Kconfig.sysbuild"
osource "/Users/ariannnahblack/zephyrproject/zephyr/soc/snps/hsdk4xd/Kconfig.sysbuild"
osource "/Users/ariannnahblack/zephyrproject/zephyr/soc/snps/hsdk/Kconfig.sysbuild"
osource "/Users/ariannnahblack/zephyrproject/zephyr/soc/snps/emsk/Kconfig.sysbuild"
osource "/Users/ariannnahblack/zephyrproject/zephyr/soc/snps/emsdp/Kconfig.sysbuild"
osource "/Users/ariannnahblack/zephyrproject/zephyr/soc/snps/arc_iot/Kconfig.sysbuild"
osource "/Users/ariannnahblack/zephyrproject/zephyr/soc/silabs/Kconfig.sysbuild"
osource "/Users/ariannnahblack/zephyrproject/zephyr/soc/sifive/sifive_freedom/Kconfig.sysbuild"
osource "/Users/ariannnahblack/zephyrproject/zephyr/soc/rockchip/Kconfig.sysbuild"
osource "/Users/ariannnahblack/zephyrproject/zephyr/soc/renode/riscv_virtual/Kconfig.sysbuild"
osource "/Users/ariannnahblack/zephyrproject/zephyr/soc/renesas/smartbond/Kconfig.sysbuild"
osource "/Users/ariannnahblack/zephyrproject/zephyr/soc/renesas/rzt2m/Kconfig.sysbuild"
osource "/Users/ariannnahblack/zephyrproject/zephyr/soc/renesas/rcar/Kconfig.sysbuild"
osource "/Users/ariannnahblack/zephyrproject/zephyr/soc/renesas/ra/Kconfig.sysbuild"
osource "/Users/ariannnahblack/zephyrproject/zephyr/soc/raspberrypi/Kconfig.sysbuild"
osource "/Users/ariannnahblack/zephyrproject/zephyr/soc/quicklogic/eos_s3/Kconfig.sysbuild"
osource "/Users/ariannnahblack/zephyrproject/zephyr/soc/qemu/virt_riscv/Kconfig.sysbuild"
osource "/Users/ariannnahblack/zephyrproject/zephyr/soc/qemu/malta/Kconfig.sysbuild"
osource "/Users/ariannnahblack/zephyrproject/zephyr/soc/openisa/rv32m1/Kconfig.sysbuild"
osource "/Users/ariannnahblack/zephyrproject/zephyr/soc/nxp/s32/Kconfig.sysbuild"
osource "/Users/ariannnahblack/zephyrproject/zephyr/soc/nxp/rw/Kconfig.sysbuild"
osource "/Users/ariannnahblack/zephyrproject/zephyr/soc/nxp/mcx/Kconfig.sysbuild"
osource "/Users/ariannnahblack/zephyrproject/zephyr/soc/nxp/lpc/Kconfig.sysbuild"
osource "/Users/ariannnahblack/zephyrproject/zephyr/soc/nxp/layerscape/Kconfig.sysbuild"
osource "/Users/ariannnahblack/zephyrproject/zephyr/soc/nxp/kinetis/Kconfig.sysbuild"
osource "/Users/ariannnahblack/zephyrproject/zephyr/soc/nxp/imxrt/Kconfig.sysbuild"
osource "/Users/ariannnahblack/zephyrproject/zephyr/soc/nxp/imx/Kconfig.sysbuild"
osource "/Users/ariannnahblack/zephyrproject/zephyr/soc/nuvoton/numicro/Kconfig.sysbuild"
osource "/Users/ariannnahblack/zephyrproject/zephyr/soc/nuvoton/numaker/Kconfig.sysbuild"
osource "/Users/ariannnahblack/zephyrproject/zephyr/soc/nuvoton/npcx/Kconfig.sysbuild"
osource "/Users/ariannnahblack/zephyrproject/zephyr/soc/nordic/Kconfig.sysbuild"
osource "/Users/ariannnahblack/zephyrproject/zephyr/soc/neorv32/Kconfig.sysbuild"
osource "/Users/ariannnahblack/zephyrproject/zephyr/soc/native/inf_clock/Kconfig.sysbuild"
osource "/Users/ariannnahblack/zephyrproject/zephyr/soc/microchip/miv/Kconfig.sysbuild"
osource "/Users/ariannnahblack/zephyrproject/zephyr/soc/microchip/mec/Kconfig.sysbuild"
osource "/Users/ariannnahblack/zephyrproject/zephyr/soc/lowrisc/opentitan/Kconfig.sysbuild"
osource "/Users/ariannnahblack/zephyrproject/zephyr/soc/litex/litex_vexriscv/Kconfig.sysbuild"
osource "/Users/ariannnahblack/zephyrproject/zephyr/soc/ite/ec/Kconfig.sysbuild"
osource "/Users/ariannnahblack/zephyrproject/zephyr/soc/intel/raptor_lake/Kconfig.sysbuild"
osource "/Users/ariannnahblack/zephyrproject/zephyr/soc/intel/lakemont/Kconfig.sysbuild"
osource "/Users/ariannnahblack/zephyrproject/zephyr/soc/intel/intel_socfpga_std/Kconfig.sysbuild"
osource "/Users/ariannnahblack/zephyrproject/zephyr/soc/intel/intel_socfpga/Kconfig.sysbuild"
osource "/Users/ariannnahblack/zephyrproject/zephyr/soc/intel/intel_niosv/Kconfig.sysbuild"
osource "/Users/ariannnahblack/zephyrproject/zephyr/soc/intel/intel_ish/Kconfig.sysbuild"
osource "/Users/ariannnahblack/zephyrproject/zephyr/soc/intel/intel_adsp/Kconfig.sysbuild"
osource "/Users/ariannnahblack/zephyrproject/zephyr/soc/intel/elkhart_lake/Kconfig.sysbuild"
osource "/Users/ariannnahblack/zephyrproject/zephyr/soc/intel/atom/Kconfig.sysbuild"
osource "/Users/ariannnahblack/zephyrproject/zephyr/soc/intel/apollo_lake/Kconfig.sysbuild"
osource "/Users/ariannnahblack/zephyrproject/zephyr/soc/intel/alder_lake/Kconfig.sysbuild"
osource "/Users/ariannnahblack/zephyrproject/zephyr/soc/infineon/xmc/Kconfig.sysbuild"
osource "/Users/ariannnahblack/zephyrproject/zephyr/soc/gd/gd32/Kconfig.sysbuild"
osource "/Users/ariannnahblack/zephyrproject/zephyr/soc/gaisler/leon3/Kconfig.sysbuild"
osource "/Users/ariannnahblack/zephyrproject/zephyr/soc/gaisler/gr716a/Kconfig.sysbuild"
osource "/Users/ariannnahblack/zephyrproject/zephyr/soc/espressif/Kconfig.sysbuild"
osource "/Users/ariannnahblack/zephyrproject/zephyr/soc/ene/kb1200/Kconfig.sysbuild"
osource "/Users/ariannnahblack/zephyrproject/zephyr/soc/efinix/sapphire/Kconfig.sysbuild"
osource "/Users/ariannnahblack/zephyrproject/zephyr/soc/cypress/Kconfig.sysbuild"
osource "/Users/ariannnahblack/zephyrproject/zephyr/soc/cdns/xtensa_sample_controller/Kconfig.sysbuild"
osource "/Users/ariannnahblack/zephyrproject/zephyr/soc/cdns/dc233c/Kconfig.sysbuild"
osource "/Users/ariannnahblack/zephyrproject/zephyr/soc/brcm/bcmvk/Kconfig.sysbuild"
osource "/Users/ariannnahblack/zephyrproject/zephyr/soc/brcm/bcm2712/Kconfig.sysbuild"
osource "/Users/ariannnahblack/zephyrproject/zephyr/soc/brcm/bcm2711/Kconfig.sysbuild"
osource "/Users/ariannnahblack/zephyrproject/zephyr/soc/atmel/sam0/Kconfig.sysbuild"
osource "/Users/ariannnahblack/zephyrproject/zephyr/soc/atmel/sam/Kconfig.sysbuild"
osource "/Users/ariannnahblack/zephyrproject/zephyr/soc/aspeed/Kconfig.sysbuild"
osource "/Users/ariannnahblack/zephyrproject/zephyr/soc/arm/Kconfig.sysbuild"
osource "/Users/ariannnahblack/zephyrproject/zephyr/soc/arm/beetle/Kconfig.sysbuild"
osource "/Users/ariannnahblack/zephyrproject/zephyr/soc/andestech/Kconfig.sysbuild"
osource "/Users/ariannnahblack/zephyrproject/zephyr/soc/ambiq/Kconfig.sysbuild"
osource "/Users/ariannnahblack/zephyrproject/zephyr/soc/altr/zephyr_nios2f/Kconfig.sysbuild"
osource "/Users/ariannnahblack/zephyrproject/zephyr/soc/altr/qemu_nios2/Kconfig.sysbuild"
```

## ble/samples/bt-fund/lesson1/blefund_less1_exer1/build/Kconfig/soc/Kconfig.defconfig
```kconfig
# Load Zephyr SoC Kconfig defconfig.
osource "/Users/ariannnahblack/zephyrproject/zephyr/soc/xlnx/zynqmp/Kconfig.defconfig"
osource "/Users/ariannnahblack/zephyrproject/zephyr/soc/xlnx/zynq7000/Kconfig.defconfig"
osource "/Users/ariannnahblack/zephyrproject/zephyr/soc/xen/Kconfig.defconfig"
osource "/Users/ariannnahblack/zephyrproject/zephyr/soc/ti/simplelink/Kconfig.defconfig"
osource "/Users/ariannnahblack/zephyrproject/zephyr/soc/ti/lm3s6965/Kconfig.defconfig"
osource "/Users/ariannnahblack/zephyrproject/zephyr/soc/ti/k3/Kconfig.defconfig"
osource "/Users/ariannnahblack/zephyrproject/zephyr/soc/telink/tlsr/Kconfig.defconfig"
osource "/Users/ariannnahblack/zephyrproject/zephyr/soc/starfive/jh71xx/Kconfig.defconfig"
osource "/Users/ariannnahblack/zephyrproject/zephyr/soc/st/stm32/Kconfig.defconfig"
osource "/Users/ariannnahblack/zephyrproject/zephyr/soc/snps/qemu_arc/Kconfig.defconfig"
osource "/Users/ariannnahblack/zephyrproject/zephyr/soc/snps/nsim/Kconfig.defconfig"
osource "/Users/ariannnahblack/zephyrproject/zephyr/soc/snps/hsdk4xd/Kconfig.defconfig"
osource "/Users/ariannnahblack/zephyrproject/zephyr/soc/snps/hsdk/Kconfig.defconfig"
osource "/Users/ariannnahblack/zephyrproject/zephyr/soc/snps/emsk/Kconfig.defconfig"
osource "/Users/ariannnahblack/zephyrproject/zephyr/soc/snps/emsdp/Kconfig.defconfig"
osource "/Users/ariannnahblack/zephyrproject/zephyr/soc/snps/arc_iot/Kconfig.defconfig"
osource "/Users/ariannnahblack/zephyrproject/zephyr/soc/silabs/Kconfig.defconfig"
osource "/Users/ariannnahblack/zephyrproject/zephyr/soc/sifive/sifive_freedom/Kconfig.defconfig"
osource "/Users/ariannnahblack/zephyrproject/zephyr/soc/rockchip/Kconfig.defconfig"
osource "/Users/ariannnahblack/zephyrproject/zephyr/soc/renode/riscv_virtual/Kconfig.defconfig"
osource "/Users/ariannnahblack/zephyrproject/zephyr/soc/renesas/smartbond/Kconfig.defconfig"
osource "/Users/ariannnahblack/zephyrproject/zephyr/soc/renesas/rzt2m/Kconfig.defconfig"
osource "/Users/ariannnahblack/zephyrproject/zephyr/soc/renesas/rcar/Kconfig.defconfig"
osource "/Users/ariannnahblack/zephyrproject/zephyr/soc/renesas/ra/Kconfig.defconfig"
osource "/Users/ariannnahblack/zephyrproject/zephyr/soc/raspberrypi/Kconfig.defconfig"
osource "/Users/ariannnahblack/zephyrproject/zephyr/soc/quicklogic/eos_s3/Kconfig.defconfig"
osource "/Users/ariannnahblack/zephyrproject/zephyr/soc/qemu/virt_riscv/Kconfig.defconfig"
osource "/Users/ariannnahblack/zephyrproject/zephyr/soc/qemu/malta/Kconfig.defconfig"
osource "/Users/ariannnahblack/zephyrproject/zephyr/soc/openisa/rv32m1/Kconfig.defconfig"
osource "/Users/ariannnahblack/zephyrproject/zephyr/soc/nxp/s32/Kconfig.defconfig"
osource "/Users/ariannnahblack/zephyrproject/zephyr/soc/nxp/rw/Kconfig.defconfig"
osource "/Users/ariannnahblack/zephyrproject/zephyr/soc/nxp/mcx/Kconfig.defconfig"
osource "/Users/ariannnahblack/zephyrproject/zephyr/soc/nxp/lpc/Kconfig.defconfig"
osource "/Users/ariannnahblack/zephyrproject/zephyr/soc/nxp/layerscape/Kconfig.defconfig"
osource "/Users/ariannnahblack/zephyrproject/zephyr/soc/nxp/kinetis/Kconfig.defconfig"
osource "/Users/ariannnahblack/zephyrproject/zephyr/soc/nxp/imxrt/Kconfig.defconfig"
osource "/Users/ariannnahblack/zephyrproject/zephyr/soc/nxp/imx/Kconfig.defconfig"
osource "/Users/ariannnahblack/zephyrproject/zephyr/soc/nuvoton/numicro/Kconfig.defconfig"
osource "/Users/ariannnahblack/zephyrproject/zephyr/soc/nuvoton/numaker/Kconfig.defconfig"
osource "/Users/ariannnahblack/zephyrproject/zephyr/soc/nuvoton/npcx/Kconfig.defconfig"
osource "/Users/ariannnahblack/zephyrproject/zephyr/soc/nordic/Kconfig.defconfig"
osource "/Users/ariannnahblack/zephyrproject/zephyr/soc/neorv32/Kconfig.defconfig"
osource "/Users/ariannnahblack/zephyrproject/zephyr/soc/native/inf_clock/Kconfig.defconfig"
osource "/Users/ariannnahblack/zephyrproject/zephyr/soc/microchip/miv/Kconfig.defconfig"
osource "/Users/ariannnahblack/zephyrproject/zephyr/soc/microchip/mec/Kconfig.defconfig"
osource "/Users/ariannnahblack/zephyrproject/zephyr/soc/lowrisc/opentitan/Kconfig.defconfig"
osource "/Users/ariannnahblack/zephyrproject/zephyr/soc/litex/litex_vexriscv/Kconfig.defconfig"
osource "/Users/ariannnahblack/zephyrproject/zephyr/soc/ite/ec/Kconfig.defconfig"
osource "/Users/ariannnahblack/zephyrproject/zephyr/soc/intel/raptor_lake/Kconfig.defconfig"
osource "/Users/ariannnahblack/zephyrproject/zephyr/soc/intel/lakemont/Kconfig.defconfig"
osource "/Users/ariannnahblack/zephyrproject/zephyr/soc/intel/intel_socfpga_std/Kconfig.defconfig"
osource "/Users/ariannnahblack/zephyrproject/zephyr/soc/intel/intel_socfpga/Kconfig.defconfig"
osource "/Users/ariannnahblack/zephyrproject/zephyr/soc/intel/intel_niosv/Kconfig.defconfig"
osource "/Users/ariannnahblack/zephyrproject/zephyr/soc/intel/intel_ish/Kconfig.defconfig"
osource "/Users/ariannnahblack/zephyrproject/zephyr/soc/intel/intel_adsp/Kconfig.defconfig"
osource "/Users/ariannnahblack/zephyrproject/zephyr/soc/intel/elkhart_lake/Kconfig.defconfig"
osource "/Users/ariannnahblack/zephyrproject/zephyr/soc/intel/atom/Kconfig.defconfig"
osource "/Users/ariannnahblack/zephyrproject/zephyr/soc/intel/apollo_lake/Kconfig.defconfig"
osource "/Users/ariannnahblack/zephyrproject/zephyr/soc/intel/alder_lake/Kconfig.defconfig"
osource "/Users/ariannnahblack/zephyrproject/zephyr/soc/infineon/xmc/Kconfig.defconfig"
osource "/Users/ariannnahblack/zephyrproject/zephyr/soc/gd/gd32/Kconfig.defconfig"
osource "/Users/ariannnahblack/zephyrproject/zephyr/soc/gaisler/leon3/Kconfig.defconfig"
osource "/Users/ariannnahblack/zephyrproject/zephyr/soc/gaisler/gr716a/Kconfig.defconfig"
osource "/Users/ariannnahblack/zephyrproject/zephyr/soc/espressif/Kconfig.defconfig"
osource "/Users/ariannnahblack/zephyrproject/zephyr/soc/ene/kb1200/Kconfig.defconfig"
osource "/Users/ariannnahblack/zephyrproject/zephyr/soc/efinix/sapphire/Kconfig.defconfig"
osource "/Users/ariannnahblack/zephyrproject/zephyr/soc/cypress/Kconfig.defconfig"
osource "/Users/ariannnahblack/zephyrproject/zephyr/soc/cdns/xtensa_sample_controller/Kconfig.defconfig"
osource "/Users/ariannnahblack/zephyrproject/zephyr/soc/cdns/dc233c/Kconfig.defconfig"
osource "/Users/ariannnahblack/zephyrproject/zephyr/soc/brcm/bcmvk/Kconfig.defconfig"
osource "/Users/ariannnahblack/zephyrproject/zephyr/soc/brcm/bcm2712/Kconfig.defconfig"
osource "/Users/ariannnahblack/zephyrproject/zephyr/soc/brcm/bcm2711/Kconfig.defconfig"
osource "/Users/ariannnahblack/zephyrproject/zephyr/soc/atmel/sam0/Kconfig.defconfig"
osource "/Users/ariannnahblack/zephyrproject/zephyr/soc/atmel/sam/Kconfig.defconfig"
osource "/Users/ariannnahblack/zephyrproject/zephyr/soc/aspeed/Kconfig.defconfig"
osource "/Users/ariannnahblack/zephyrproject/zephyr/soc/arm/Kconfig.defconfig"
osource "/Users/ariannnahblack/zephyrproject/zephyr/soc/arm/beetle/Kconfig.defconfig"
osource "/Users/ariannnahblack/zephyrproject/zephyr/soc/andestech/Kconfig.defconfig"
osource "/Users/ariannnahblack/zephyrproject/zephyr/soc/ambiq/Kconfig.defconfig"
osource "/Users/ariannnahblack/zephyrproject/zephyr/soc/altr/zephyr_nios2f/Kconfig.defconfig"
osource "/Users/ariannnahblack/zephyrproject/zephyr/soc/altr/qemu_nios2/Kconfig.defconfig"
```

## custom_service/build/Kconfig/arch/Kconfig
```kconfig
# Load arch Kconfig descriptions.
osource "/Users/ariannnahblack/zephyrproject/zephyr/arch/x86/Kconfig"
osource "/Users/ariannnahblack/zephyrproject/zephyr/arch/xtensa/Kconfig"
osource "/Users/ariannnahblack/zephyrproject/zephyr/arch/sparc/Kconfig"
osource "/Users/ariannnahblack/zephyrproject/zephyr/arch/riscv/Kconfig"
osource "/Users/ariannnahblack/zephyrproject/zephyr/arch/posix/Kconfig"
osource "/Users/ariannnahblack/zephyrproject/zephyr/arch/nios2/Kconfig"
osource "/Users/ariannnahblack/zephyrproject/zephyr/arch/mips/Kconfig"
osource "/Users/ariannnahblack/zephyrproject/zephyr/arch/arm64/Kconfig"
osource "/Users/ariannnahblack/zephyrproject/zephyr/arch/arm/Kconfig"
osource "/Users/ariannnahblack/zephyrproject/zephyr/arch/arc/Kconfig"
```
