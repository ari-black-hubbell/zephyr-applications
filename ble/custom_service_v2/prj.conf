## CMakeLists.txt
```
cmake_minimum_required(VERSION 3.20.0)
find_package(Zephyr REQUIRED HINTS $ENV{ZEPHYR_BASE})

project(custom_service_v2)

target_sources(app PRIVATE src/main.c)
```

## prj.conf
```kconfig
## configure buttons and LEDs
CONFIG_GPIO=y       ## enable GPIOs

## log 
CONFIG_LOG=y

## bluetooth
CONFIG_BT=y                     ## enable bluetooth
CONFIG_BT_PERIPHERAL=y          ## configure the device to be a peripheral
CONFIG_BT_DEVICE_NAME="device"  ## device name (required)
```

## src/main.c
```c
/* main.c */

/* module imports */ 
#include "ble_cus.h"

/* (macro) add a custom service instance named m_cus */
BLE_CUS_DEF(m_cus);

/* macros from starter template */
#define DEVICE_NAME                     "Nordic_Template"                       /**< Name of device. Will be included in the advertising data. */
#define MANUFACTURER_NAME               "NordicSemiconductor"                   /**< Manufacturer. Will be passed to Device Information Service. */
#define APP_ADV_INTERVAL                300                                     /**< The advertising interval (in units of 0.625 ms. This value corresponds to 187.5 ms). */

#define APP_ADV_DURATION                18000                                   /**< The advertising duration (180 seconds) in units of 10 milliseconds. */
#define APP_BLE_OBSERVER_PRIO           3                                       /**< Application's BLE observer priority. You shouldn't need to modify this value. */
#define APP_BLE_CONN_CFG_TAG            1                                       /**< A tag identifying the SoftDevice BLE configuration. */

#define MIN_CONN_INTERVAL               MSEC_TO_UNITS(100, UNIT_1_25_MS)        /**< Minimum acceptable connection interval (0.1 seconds). */
#define MAX_CONN_INTERVAL               MSEC_TO_UNITS(200, UNIT_1_25_MS)        /**< Maximum acceptable connection interval (0.2 second). */
#define SLAVE_LATENCY                   0                                       /**< Slave latency. */
#define CONN_SUP_TIMEOUT                MSEC_TO_UNITS(4000, UNIT_10_MS)         /**< Connection supervisory timeout (4 seconds). */

#define FIRST_CONN_PARAMS_UPDATE_DELAY  APP_TIMER_TICKS(5000)                   /**< Time from initiating event (connect or start of notification) to first time sd_ble_gap_conn_param_update is called (5 seconds). */
#define NEXT_CONN_PARAMS_UPDATE_DELAY   APP_TIMER_TICKS(30000)                  /**< Time between each call to sd_ble_gap_conn_param_update after the first call (30 seconds). */
#define MAX_CONN_PARAMS_UPDATE_COUNT    3                                       /**< Number of attempts before giving up the connection parameter negotiation. */

#define NOTIFICATION_INTERVAL           APP_TIMER_TICKS(1000)     

#define SEC_PARAM_BOND                  1                                       /**< Perform bonding. */
#define SEC_PARAM_MITM                  0                                       /**< Man In The Middle protection not required. */
#define SEC_PARAM_LESC                  0                                       /**< LE Secure Connections not enabled. */
#define SEC_PARAM_KEYPRESS              0                                       /**< Keypress notifications not enabled. */
#define SEC_PARAM_IO_CAPABILITIES       BLE_GAP_IO_CAPS_NONE                    /**< No I/O capabilities. */
#define SEC_PARAM_OOB                   0                                       /**< Out Of Band data not available. */
#define SEC_PARAM_MIN_KEY_SIZE          7                                       /**< Minimum encryption key size. */
#define SEC_PARAM_MAX_KEY_SIZE          16                                      /**< Maximum encryption key size. */

#define DEAD_BEEF                       0xDEADBEEF                              /**< Value used as error code on stack dump, can be used to identify stack location on stack unwind. */

/* macros / definitions from starter template */
NRF_BLE_GATT_DEF(m_gatt);
NRF_BLE_QWR_DEF(m_qwr);                                                         /**< GATT module instance. */
BLE_ADVERTISING_DEF(m_advertising);                                             /**< Advertising module instance. */
APP_TIMER_DEF(m_notification_timer_id);
static uint8_t m_custom_value = 0;

/* add the 128 bit UUID to the advertisement packet */
static ble_uuid_t m_adv_uuids[] = {{CUSTOM_SERVICE_UUID, BLE_UUID_TYPE_VENDOR_BEGIN}};


/* initialize services to be used by the application */
static void services_init(void) {

    // initialize variables
    ret_code_t          err_code;
    ble_cus_init_t      cus_init;

    // initialize custom service init structure to zero
    memset(&cus_init, 0, sizeof(cus_init));

    // call custom service init function
    err_code = ble_cus_init(&m_cus, &cus_init);
    APP_ERROR_CHECK(err_code);
}

int main() {
    
    return 0;
}
```

## src/ble_cus.c
```c
/* ble_cus.c */

/* module imports */ 
// standard c
#include <string.h>

// local files
#include "ble_cus.h"

// zephyr library
#include <zephyr/kernel.h>
#include <zephyr/logging/log.h>
#include <zephyr/bluetooth/bluetooth.h>
#include <zephyr/bluetooth/conn.h>
#include <zephyr/bluetooth/gatt.h>
#include <zephyr/bluetooth/uuid.h>

/* define custom service init function */
uint32_t ble_cus_init(ble_cus_t* p_cus, const ble_cus_init_t* p_cus_init) {
    // check that no passed-in pointers are NULL
    if (p_cus == NULL || p_cus_init == NULL) { return NRF_ERROR_NULL; }

    // declare error code and UUID variables
    uint32_t    err_code;
    ble_uuid_t  ble_uuid;

    // initialize custom service structure
    // set the connection handle to invalid (valid only when we're in a connection)
    p_cus->conn_handle = BLE_CONN_HANDLE_INVALID;

    // add custom base UUID to BLE stack's table
    ble_uuid128_t base_uuid = {CUSTOM_SERVICE_UUID_BASE};
    err_code = sd_ble_uuid_vs_add(&base_uuid, &p_cus->uuid_type);
    VERIFY_SUCCESS(err_code);

    // set custom BLE UUID's attributes (type and UUID)
    ble_uuid.type = p_cus->uuid_type;
    ble_uuid.uuid = CUSTOM_SERVICE_UUID;

    // add the custom service declaration to the BLE stack's GATT table
    err_code = sd_ble_gatts_service_add(BLE_GATTS_SRVC_TYPE_PRIMARY, &ble_uuid, &p_cus->service_handle);
    if (err_code != NRF_SUCCESS) { return err_code; }
}
```

## src/ble_cus.h
```c
/* ble_cus.h */

#ifndef BLE_CUS_H__
#define BLE_CUS_H__

/* module imports */ 
#include <stdint.h>
#include <stdbool.h>

/* select a 128-bit UUID (any value) */
// website: https://www.uuidgenerator.net/version4
// f8cab862-55ff-4069-a3a9-fa3f30f4e8c1

/* (macro) define our custom UUID base (reverse byte-order) */
// 0xC1, 0xE8, 0xF4, 0x30, 0x3F, 0xFA, 0xA9, 0xA3, 0x69, 0x40, 0xFF, 0x55, 0x62, 0xB8, 0xCA, 0xF8
#define CUSTOM_SERVICE_UUID_BASE { 0xC1, 0xE8, 0xF4, 0x30, 0x3F, 0xFA, 0xA9, 0xA3, \
                                   0x69, 0x40, 0xFF, 0x55, 0x62, 0xB8, 0xCA, 0xF8 }

/* (macro) define 16-bit UUIDs for our custom service / characteristic (any value) */
// note: these values will be inserted later into the base UUID
#define CUSTOM_SERVICE_UUID     0x1900  // service
#define CUSTOM_VALUE_CHAR_UUID  0x1901  // value characteristic

/* (macro) define custom service instance */
#define BLE_CUS_DEF(_name) 
    static ble_cus_t _name;

/* (struct) define custom service init structure to hold all options/data for initialization */
typedef struct {
    uint8_t                         initial_custom_value;       // initial custom value
    ble_srv_cccd_security_mode_t    custom_value_char_attr_md;  // initial security level, characteristics
} ble_cus_init_t;

/* (struct) define custom service structure to hold status information of the service */
struct ble_cus_s {
    uint16_t                    service_handle;         // handle (alias) for custom service
    ble_gatts_char_handles_t    custom_value_handles;   // handles related to custom value characteristic
    uint16_t                    conn_handle;            // handle of current connection
    uint8_t                     uuid_type;
}

/* create a forward declaration of the custom service instance type (since this is a header) */
typedef struct ble_cus_s ble_cus_t;

/* declare custom service init function. */
/**@brief Function for initializing the Custom Service.
 *
 * @param[out]  p_cus       Custom Service structure. This structure will have to be supplied by
 *                          the application. It will be initialized by this function, and will later
 *                          be used to identify this particular service instance.
 * @param[in]   p_cus_init  Information needed to initialize the service.
 *
 * @return      NRF_SUCCESS on successful initialization of service, otherwise an error code.
 */
uint32_t ble_cus_init(ble_cus_t* p_cus, const ble_cus_init_t* p_cus_init);
```
