## custom_service/build/Kconfig/soc/Kconfig
```kconfig
# Load Zephyr SoC Kconfig descriptions.
osource "/Users/ariannnahblack/zephyrproject/zephyr/soc/xlnx/zynqmp/Kconfig"
osource "/Users/ariannnahblack/zephyrproject/zephyr/soc/xlnx/zynq7000/Kconfig"
osource "/Users/ariannnahblack/zephyrproject/zephyr/soc/xen/Kconfig"
osource "/Users/ariannnahblack/zephyrproject/zephyr/soc/ti/simplelink/Kconfig"
osource "/Users/ariannnahblack/zephyrproject/zephyr/soc/ti/lm3s6965/Kconfig"
osource "/Users/ariannnahblack/zephyrproject/zephyr/soc/ti/k3/Kconfig"
osource "/Users/ariannnahblack/zephyrproject/zephyr/soc/telink/tlsr/Kconfig"
osource "/Users/ariannnahblack/zephyrproject/zephyr/soc/starfive/jh71xx/Kconfig"
osource "/Users/ariannnahblack/zephyrproject/zephyr/soc/st/stm32/Kconfig"
osource "/Users/ariannnahblack/zephyrproject/zephyr/soc/snps/qemu_arc/Kconfig"
osource "/Users/ariannnahblack/zephyrproject/zephyr/soc/snps/nsim/Kconfig"
osource "/Users/ariannnahblack/zephyrproject/zephyr/soc/snps/hsdk4xd/Kconfig"
osource "/Users/ariannnahblack/zephyrproject/zephyr/soc/snps/hsdk/Kconfig"
osource "/Users/ariannnahblack/zephyrproject/zephyr/soc/snps/emsk/Kconfig"
osource "/Users/ariannnahblack/zephyrproject/zephyr/soc/snps/emsdp/Kconfig"
osource "/Users/ariannnahblack/zephyrproject/zephyr/soc/snps/arc_iot/Kconfig"
osource "/Users/ariannnahblack/zephyrproject/zephyr/soc/silabs/Kconfig"
osource "/Users/ariannnahblack/zephyrproject/zephyr/soc/sifive/sifive_freedom/Kconfig"
osource "/Users/ariannnahblack/zephyrproject/zephyr/soc/rockchip/Kconfig"
osource "/Users/ariannnahblack/zephyrproject/zephyr/soc/renode/riscv_virtual/Kconfig"
osource "/Users/ariannnahblack/zephyrproject/zephyr/soc/renesas/smartbond/Kconfig"
osource "/Users/ariannnahblack/zephyrproject/zephyr/soc/renesas/rzt2m/Kconfig"
osource "/Users/ariannnahblack/zephyrproject/zephyr/soc/renesas/rcar/Kconfig"
osource "/Users/ariannnahblack/zephyrproject/zephyr/soc/renesas/ra/Kconfig"
osource "/Users/ariannnahblack/zephyrproject/zephyr/soc/raspberrypi/Kconfig"
osource "/Users/ariannnahblack/zephyrproject/zephyr/soc/quicklogic/eos_s3/Kconfig"
osource "/Users/ariannnahblack/zephyrproject/zephyr/soc/qemu/virt_riscv/Kconfig"
osource "/Users/ariannnahblack/zephyrproject/zephyr/soc/qemu/malta/Kconfig"
osource "/Users/ariannnahblack/zephyrproject/zephyr/soc/openisa/rv32m1/Kconfig"
osource "/Users/ariannnahblack/zephyrproject/zephyr/soc/nxp/s32/Kconfig"
osource "/Users/ariannnahblack/zephyrproject/zephyr/soc/nxp/rw/Kconfig"
osource "/Users/ariannnahblack/zephyrproject/zephyr/soc/nxp/mcx/Kconfig"
osource "/Users/ariannnahblack/zephyrproject/zephyr/soc/nxp/lpc/Kconfig"
osource "/Users/ariannnahblack/zephyrproject/zephyr/soc/nxp/layerscape/Kconfig"
osource "/Users/ariannnahblack/zephyrproject/zephyr/soc/nxp/kinetis/Kconfig"
osource "/Users/ariannnahblack/zephyrproject/zephyr/soc/nxp/imxrt/Kconfig"
osource "/Users/ariannnahblack/zephyrproject/zephyr/soc/nxp/imx/Kconfig"
osource "/Users/ariannnahblack/zephyrproject/zephyr/soc/nuvoton/numicro/Kconfig"
osource "/Users/ariannnahblack/zephyrproject/zephyr/soc/nuvoton/numaker/Kconfig"
osource "/Users/ariannnahblack/zephyrproject/zephyr/soc/nuvoton/npcx/Kconfig"
osource "/Users/ariannnahblack/zephyrproject/zephyr/soc/nordic/Kconfig"
osource "/Users/ariannnahblack/zephyrproject/zephyr/soc/neorv32/Kconfig"
osource "/Users/ariannnahblack/zephyrproject/zephyr/soc/native/inf_clock/Kconfig"
osource "/Users/ariannnahblack/zephyrproject/zephyr/soc/microchip/miv/Kconfig"
osource "/Users/ariannnahblack/zephyrproject/zephyr/soc/microchip/mec/Kconfig"
osource "/Users/ariannnahblack/zephyrproject/zephyr/soc/lowrisc/opentitan/Kconfig"
osource "/Users/ariannnahblack/zephyrproject/zephyr/soc/litex/litex_vexriscv/Kconfig"
osource "/Users/ariannnahblack/zephyrproject/zephyr/soc/ite/ec/Kconfig"
osource "/Users/ariannnahblack/zephyrproject/zephyr/soc/intel/raptor_lake/Kconfig"
osource "/Users/ariannnahblack/zephyrproject/zephyr/soc/intel/lakemont/Kconfig"
osource "/Users/ariannnahblack/zephyrproject/zephyr/soc/intel/intel_socfpga_std/Kconfig"
osource "/Users/ariannnahblack/zephyrproject/zephyr/soc/intel/intel_socfpga/Kconfig"
osource "/Users/ariannnahblack/zephyrproject/zephyr/soc/intel/intel_niosv/Kconfig"
osource "/Users/ariannnahblack/zephyrproject/zephyr/soc/intel/intel_ish/Kconfig"
osource "/Users/ariannnahblack/zephyrproject/zephyr/soc/intel/intel_adsp/Kconfig"
osource "/Users/ariannnahblack/zephyrproject/zephyr/soc/intel/elkhart_lake/Kconfig"
osource "/Users/ariannnahblack/zephyrproject/zephyr/soc/intel/atom/Kconfig"
osource "/Users/ariannnahblack/zephyrproject/zephyr/soc/intel/apollo_lake/Kconfig"
osource "/Users/ariannnahblack/zephyrproject/zephyr/soc/intel/alder_lake/Kconfig"
osource "/Users/ariannnahblack/zephyrproject/zephyr/soc/infineon/xmc/Kconfig"
osource "/Users/ariannnahblack/zephyrproject/zephyr/soc/gd/gd32/Kconfig"
osource "/Users/ariannnahblack/zephyrproject/zephyr/soc/gaisler/leon3/Kconfig"
osource "/Users/ariannnahblack/zephyrproject/zephyr/soc/gaisler/gr716a/Kconfig"
osource "/Users/ariannnahblack/zephyrproject/zephyr/soc/espressif/Kconfig"
osource "/Users/ariannnahblack/zephyrproject/zephyr/soc/ene/kb1200/Kconfig"
osource "/Users/ariannnahblack/zephyrproject/zephyr/soc/efinix/sapphire/Kconfig"
osource "/Users/ariannnahblack/zephyrproject/zephyr/soc/cypress/Kconfig"
osource "/Users/ariannnahblack/zephyrproject/zephyr/soc/cdns/xtensa_sample_controller/Kconfig"
osource "/Users/ariannnahblack/zephyrproject/zephyr/soc/cdns/dc233c/Kconfig"
osource "/Users/ariannnahblack/zephyrproject/zephyr/soc/brcm/bcmvk/Kconfig"
osource "/Users/ariannnahblack/zephyrproject/zephyr/soc/brcm/bcm2712/Kconfig"
osource "/Users/ariannnahblack/zephyrproject/zephyr/soc/brcm/bcm2711/Kconfig"
osource "/Users/ariannnahblack/zephyrproject/zephyr/soc/atmel/sam0/Kconfig"
osource "/Users/ariannnahblack/zephyrproject/zephyr/soc/atmel/sam/Kconfig"
osource "/Users/ariannnahblack/zephyrproject/zephyr/soc/aspeed/Kconfig"
osource "/Users/ariannnahblack/zephyrproject/zephyr/soc/arm/Kconfig"
osource "/Users/ariannnahblack/zephyrproject/zephyr/soc/arm/beetle/Kconfig"
osource "/Users/ariannnahblack/zephyrproject/zephyr/soc/andestech/Kconfig"
osource "/Users/ariannnahblack/zephyrproject/zephyr/soc/ambiq/Kconfig"
osource "/Users/ariannnahblack/zephyrproject/zephyr/soc/altr/zephyr_nios2f/Kconfig"
osource "/Users/ariannnahblack/zephyrproject/zephyr/soc/altr/qemu_nios2/Kconfig"
```
